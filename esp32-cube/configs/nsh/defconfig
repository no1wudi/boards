## esp32s3/Kconfig
```kconfig
#
# For a description of the syntax of this configuration file,
# see the file kconfig-language.txt in the NuttX tools repository.
#

config BOARD_ESP32S3_BUZZER
    bool "Enable buzzer"

if BOARD_ESP32S3_BUZZER

config BOARD_ESP32S3_BUZZER_PIN
    int "Buzzer pin"
    default 33

endif # BOARD_ESP32S3_BUZZER

if LCD_ST7789

config BOARD_ESP32S3_LCD_ST7789_DC_PIN
    int "LCD ST7789 DC pin"
    default 4

config BOARD_ESP32S3_LCD_ST7789_RST_PIN
    int "LCD ST7789 RST pin"
    default 8

config BOARD_ESP32S3_LCD_ST7789_BL_PIN
    int "LCD ST7789 Backlight pin"
    default 15

endif # LCD_ST7789

config BOARD_ESP32S3_TP_RST_PIN
    int "Touch Panel RST pin"
    default 13

config BOARD_ESP32S3_TP_INT_PIN
    int "Touch Panel INT pin"
    default 14
```
